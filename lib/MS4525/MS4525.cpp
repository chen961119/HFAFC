/***********************************************************************
**---------------------------------------------------------------------
**文件名：MS4525.cppp
**文件说明：MS4525读取大气参数
**---------------------------------------------------------------------
***********************************************************************/
#include "MS4525.h"
#include <Wire.h>
/***********************************************************************
**函数名：MS4525read_Task::readMS4525()
**函数说明：读取MS4525压力和温度函数
**---------------------------------------------------------------------
**输入参数：无
**返回参数：TRUE/FALSE
***********************************************************************/
bool MS4525read_Task::readMS4525()
{
    MS4525_wire->requestFrom(I2C_ADDR, uint8_t(4));
    if (MS4525_wire->available() != 4) 
    {
        
        return false;
    }
  for (int i = 0; i < 4; ++i) buf[i] = MS4525_wire->read();
  uint16_t P_counts = ((buf[0] & 0x3F) << 8) | buf[1];//静压减动压
  uint16_t T_counts = ((buf[2] << 3) | (buf[3] >> 5));
  MS4525_param.pressure=(P_counts-COUNTS_MIN) *(Pmax-Pmin)/COUNTS_MAX+Pmin;
  MS4525_param.temperature= float(T_counts) * 200.0f / 2047.0f - 50.0f;
  
  return true;    
}
/***********************************************************************
**函数名：MS4525read_Task::calib()
**函数说明：MS4525压力校零漂函数
**---------------------------------------------------------------------
**输入参数：无
**返回参数：无
***********************************************************************/
void MS4525read_Task::calib()
{
  uint16_t count=0;
  while(count++<1000)
  {
  readMS4525();
  MS4525_param.pressure_drift=MS4525_param.pressure_drift+MS4525_param.pressure;
  }
  MS4525_param.pressure_drift=MS4525_param.pressure_drift/1000;
}